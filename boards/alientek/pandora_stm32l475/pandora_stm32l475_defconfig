## boards/alientek/pandora_stm32l475/pandora_stm32l475_defconfig
```kconfig
# SPDX-License-Identifier: Apache-2.0

# Enable MPU
CONFIG_ARM_MPU=y

# Enable HW stack protection
CONFIG_HW_STACK_PROTECTION=y

# enable uart driver
CONFIG_SERIAL=y

# enable GPIO
CONFIG_GPIO=y

# Enable Clocks
CONFIG_CLOCK_CONTROL=y

# console
CONFIG_CONSOLE=y
CONFIG_UART_CONSOLE=y

# enable pin controller
CONFIG_PINCTRL=y

CONFIG_MAIN_STACK_SIZE=2048
CONFIG_COMMON_LIBC_MALLOC_ARENA_SIZE=8192

CONFIG_DISK_ACCESS=y
CONFIG_DISK_DRIVERS=y
CONFIG_DISK_DRIVER_SDMMC=y

CONFIG_FILE_SYSTEM=y
CONFIG_FAT_FILESYSTEM_ELM=y

# CONFIG_APP_MSC_STORAGE_SDCARD=y
```

## boards/riscv/sipeed_maix_bit/Kconfig.board
```kconfig
# Sipeed MaixBit board configuration
# SPDX-License-Identifier: Apache-2.0

config BOARD_SIPEED_MAIX_BIT
	bool "SIPEED MAIX_BIT Board"
	depends on SOC_SERIES_CANAAN_K210

choice SOC_PART_NUMBER
	default SOC_CANAAN_K210
endchoice
```

## boards/riscv/sipeed_maix_bit/Kconfig.defconfig
```kconfig
# Sipeed Maix Bit board configuration
# SPDX-License-Identifier: Apache-2.0

config BOARD
	default "sipeed_maix_bit"
	depends on BOARD_SIPEED_MAIX_BIT

config HEAP_MEM_POOL_ADD_SIZE_BOARD
	int
	default 4096
```

## boards/riscv/sipeed_maix_bit/sipeed_maix_bit_defconfig
```kconfig
# SPDX-License-Identifier: Apache-2.0

CONFIG_BOARD_SIPEED_MAIX_BIT=y
CONFIG_SOC_SERIES_CANAAN_K210=y

CONFIG_MAIN_STACK_SIZE=2048

CONFIG_CONSOLE=y
CONFIG_SERIAL=y
CONFIG_UART_CONSOLE=y
CONFIG_GPIO=y
```

## boards/riscv/sipeed_maixbit_k210/Kconfig.defconfig
```kconfig
# Copyright (c) 2019 BayLibre SAS
# SPDX-License-Identifier: Apache-2.0

config BUILD_OUTPUT_BIN
	default n

config BOARD
	default "sipeed_maixbit_k210" if BOARD_SIPEED_MAIXBIT_K210
	default "sipeed_maixbit_k210_smp" if BOARD_SIPEED_MAIXBIT_K210_SMP
```

## boards/weact/mini_stm32h750vb/Kconfig.mini_stm32h750vb
```kconfig
# Copyright (c) 2023 STMicroelectronics
# SPDX-License-Identifier: Apache-2.0

config BOARD_MINI_STM32H750VB
	select SOC_STM32H750XX
```

## drivers/sensor/tdk/icm20608/Kconfig
```kconfig
# ICM20608 Six-Axis Motion Tracking device configuration options

# Copyright (c) 2016 Intel Corporation
# SPDX-License-Identifier: Apache-2.0

menuconfig ICM20608
	bool "ICM20608 Six-Axis Motion Tracking Device"
	default y
	depends on DT_HAS_INVENSENSE_ICM20608_ENABLED
	select I2C
	help
	  Enable driver for ICM20608 I2C-based six-axis motion tracking device.

if ICM20608

choice
	prompt "Trigger mode"
	default ICM20608_TRIGGER_GLOBAL_THREAD
	help
	  Specify the type of triggering to be used by the driver.

config ICM20608_TRIGGER_NONE
	bool "No trigger"

config ICM20608_TRIGGER_GLOBAL_THREAD
	bool "Use global thread"
	depends on GPIO
	select ICM20608_TRIGGER

config ICM20608_TRIGGER_OWN_THREAD
	bool "Use own thread"
	depends on GPIO
	select ICM20608_TRIGGER

endchoice

config ICM20608_TRIGGER
	bool

config ICM20608_THREAD_PRIORITY
	int "Thread priority"
	depends on ICM20608_TRIGGER_OWN_THREAD
	default 10
	help
	  Priority of thread used by the driver to handle interrupts.

config ICM20608_THREAD_STACK_SIZE
	int "Thread stack size"
	depends on ICM20608_TRIGGER_OWN_THREAD
	default 1024
	help
	  Stack size of thread used by the driver to handle interrupts.

config ICM20608_ACCEL_FS
	int "Accelerometer full-scale range"
	default 2
	help
	  Magnetometer full-scale range.
	  An X value for the config represents a range of +/- X g. Valid
	  values are 2, 4, 8 and 16.

config ICM20608_GYRO_FS
	int "Gyroscope full-scale range"
	default 250
	help
	  Gyroscope full-scale range.
	  An X value for the config represents a range of +/- X degrees/second.
	  Valid values are 250, 500, 1000, 2000.

endif # ICM20608
```

## dts/bindings/sensor/invensense,icm20608.yaml
```yaml
# Copyright (c) 2019 Nordic Semiconductor ASA
# SPDX-License-Identifier: Apache-2.0

description: ICM20608 motion tracking device

# ICM20608 is SPI or I2C.  Driver does not
# support SPI so stick with I2C variant.
compatible: "invensense,icm20608"

include: [sensor-device.yaml, i2c-device.yaml]

properties:
  int-gpios:
    type: phandle-array
    description: |
      The INT signal default configuration is active-high.  The
      property value should ensure the flags properly describe the
      signal that is presented to the driver.
```

## soc/riscv/canaan/Kconfig
```kconfig
# SPDX-License-Identifier: Apache-2.0

config SOC_FAMILY_CANAN_K210
	bool

if SOC_FAMILY_CANAN_K210

config SOC_FAMILY
	string
	default "canaan_k210"

source "soc/riscv/canaan_k210/common/Kconfig.soc"
source "soc/riscv/canaan_k210/*/Kconfig.soc"

endif # SOC_FAMILY_CANAN_K210
```

## soc/riscv/canaan/Kconfig.defconfig
```kconfig
# SPDX-License-Identifier: Apache-2.0

source "soc/riscv/canaan_k210/common/Kconfig.defconfig.series"
source "soc/riscv/canaan_k210/*/Kconfig.defconfig.series"
```
